/* Copyright (c) 2015, The Linux Foundation. All rights reserved.
 *
 * This program is free software; you can redistribute it and/or modify
 * it under the terms of the GNU General Public License version 2 and
 * only version 2 as published by the Free Software Foundation.
 *
 * This program is distributed in the hope that it will be useful,
 * but WITHOUT ANY WARRANTY; without even the implied warranty of
 * MERCHANTABILITY or FITNESS FOR A PARTICULAR PURPOSE.  See the
 * GNU General Public License for more details.
 */

#include "zte-msm8996-common.dtsi"

&soc {
    goodix_gf3118@1 {
        compatible = "goodix,fingerprint";
        //reg = <0x1>;
        spi-max-frequency = <4800000>;
        interrupt-parent = <&tlmm>;
        interrupts = <123 0x0>;
        goodix,gpio_pwr = <&tlmm 85 0>;
        goodix,gpio_reset = <&tlmm 39 0>;
        goodix,gpio_id = <&tlmm 21 0>;
        goodix,gpio_irq = <&tlmm 123 0>;
    };
